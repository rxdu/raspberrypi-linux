#include "i2c1-overlay.dts"

/{
	fragment@0 {
		target = <&i2c_arm>;
		__overlay__ {
			#address-cells = <1>;
			#size-cells = <0>;
			status = "okay";

			iis2mdc: iis2mdc@1e {
				compatible = "st,iis2mdc_magn";
				reg = <0x1e>;
				status = "okay";
				interrupt-parent = <&gpio>;
				interrupts = <22 0x4>;
			};
		};
	};
};
